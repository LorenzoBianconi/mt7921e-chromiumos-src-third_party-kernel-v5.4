## Documentation/devicetree/bindings/regulator/mtk,mt6315-regulator.yaml
```yaml
# SPDX-License-Identifier: GPL-2.0-only OR BSD-2-Clause
%YAML 1.2
---
$id: http://devicetree.org/schemas/regulator/mtk,mt6315-regulator.yaml#
$schema: http://devicetree.org/meta-schemas/core.yaml#

title: Mediatek MT6315 Regulator

maintainers:
  - Hsin-Hsiung Wang <hsin-hsiung.wang@mediatek.com>

description: |
  The MT6315 is a power management IC (PMIC) configurable with SPMI.
  that contains 4 BUCKs output which can combine with each other
  by different efuse settings.

allOf:
  - $ref: "regulator.yaml#"

properties:
  $nodename:
    pattern: "mt6315@[0-9]"
  compatible:
    enum:
      - mediatek,mt6315_3-regulator
      - mediatek,mt6315_6-regulator
      - mediatek,mt6315_7-regulator

  reg:
    maxItems: 1

  regulators:
    type: object
    description: List of regulators and its properties

    patternProperties:
      "^vbuck[1-4]$":
        type: object

        properties:
          regulator-name:
            pattern: "^vbuck[1-4]$"
            description:
              should be "vbuck1", ..., "vbuck4"

          mtk,combined-regulator:
            $ref: "/schemas/types.yaml#/definitions/uint32-array"
            description: |
              defines other bucks combined with this buck, must contain the following
              values MT6315_VBUCK1, MT6315_VBUCK2, MT6315_VBUCK3, MT6315_VBUCK4

    unevaluatedProperties: false

required:
  - compatible
  - reg
  - regulators

additionalProperties: false

examples:
  - |
    /* This example shows that buck2 and buck4 are combined into buck1. */
    #include <dt-bindings/regulator/mtk,mt6315.h>

    mt6315@6 {
      compatible = "mediatek,mt6315_6-regulator";
      reg = <0x6 0 0xb 1>;

      regulators {
        vbuck1 {
          regulator-compatible = "vbuck1";
          regulator-min-microvolt = <300000>;
          regulator-max-microvolt = <1193750>;
          regulator-enable-ramp-delay = <256>;
          regulator-allowed-modes = <0 1 2 4>;
          mtk,combined-regulator = <MT6315_VBUCK2 MT6315_VBUCK4>;
        };

        vbuck3 {
          regulator-compatible = "vbuck3";
          regulator-min-microvolt = <300000>;
          regulator-max-microvolt = <1193750>;
          regulator-enable-ramp-delay = <256>;
          regulator-allowed-modes = <0 1 2 4>;
        };
      };
    };
```

## Documentation/devicetree/bindings/spmi/spmi-mtk-pmif.yaml
```yaml
# SPDX-License-Identifier: (GPL-2.0 OR BSD-2-Clause)
%YAML 1.2
---
$id: http://devicetree.org/schemas/spmi/spmi-mtk-pmif.yaml#
$schema: http://devicetree.org/meta-schemas/core.yaml#

title: Mediatek SPMI Controller Device Tree Bindings

maintainers:
  - Stephen Boyd <sboyd@kernel.org>
  - Matthias Brugger <matthias.bgg@gmail.com>

description: |+
  On MediaTek SoCs the PMIC is connected via SPMI and the controller allows
  for multiple SoCs to control a single SPMI master.

properties:
  compatible:
    const: mediatek,mt6873-spmi

  reg:
    minItems: 2
    maxItems: 2

  reg-names:
    items:
      - const: "pmif"
      - const: "spmimst"

  clocks:
    minItems: 3
    maxItems: 3

  clock-names:
    items:
      - const: "pmif_sys_ck"
      - const: "pmif_tmr_ck"
      - const: "spmimst_clk_mux"

  assigned-clocks:
    maxItems: 1

  assigned-clock-parents:
    maxItems: 1

required:
  - compatible
  - reg
  - reg-names
  - clocks
  - clock-names

examples:
  - |
    #include <dt-bindings/clock/mt8192-clk.h>

    spmi: spmi@10027000 {
        compatible = "mediatek,mt6873-spmi";
        reg = <0 0x10027000 0 0x000e00>,
              <0 0x10029000 0 0x000100>;
        reg-names = "pmif", "spmimst";
        clocks = <&infracfg CLK_INFRA_PMIC_AP>,
                 <&infracfg CLK_INFRA_PMIC_TMR>,
                 <&topckgen CLK_TOP_SPMI_MST_SEL>;
        clock-names = "pmif_sys_ck",
                      "pmif_tmr_ck",
                      "spmimst_clk_mux";
        assigned-clocks = <&topckgen CLK_TOP_PWRAP_ULPOSC_SEL>;
        assigned-clock-parents = <&topckgen CLK_TOP_OSC_D10>;
    };
...
```

## Documentation/devicetree/bindings/usb/typec-mode-switch.yaml
```yaml
# SPDX-License-Identifier: (GPL-2.0-only OR BSD-2-Clause)
%YAML 1.2
---
$id: http://devicetree.org/schemas/usb/typec-mode-switch.yaml#
$schema: http://devicetree.org/meta-schemas/core.yaml#

title: Typec Mode Switch Bindings

maintainers:
  - Pi-Hsun Shih <pihsun@chromium.org>

description: |-
  TODO

properties:
  compatible:
    const: typec-mode-switch

  port:
    type: object
    additionalProperties: false
    description: -|
      Connection to the remote endpoint using OF graph bindings that model SS
      data bus to typec connector.

    properties:
      endpoint:
        type: object
        additionalProperties: false

        properties:
          remote-endpoint: true

        required:
          - remote-endpoint

    required:
      - endpoint

required:
  - compatible
  - port

additionalProperties: false

examples:
  - |
    usbc_switch {
        compatible = "typec-mode-switch";

        port {
                usb3_data_ss: endpoint {
                        remote-endpoint = <&typec_con_ss>;
                };
        };
    };
```
